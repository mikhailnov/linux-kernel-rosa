## drivers/firmware/arm_scmi/vendors/baikal/Kconfig
```kconfig
# SPDX-License-Identifier: GPL-2.0-only
config BAIKAL_SCMI_BASE_EXT
	tristate "Baikal SCMI Base Extension protocol driver"
	depends on ARCH_BAIKAL || COMPILE_TEST
	depends on ARM_SCMI_PROTOCOL
	select ARM_SCMI_TRANSPORT_MAILBOX
	select BAIKAL_MBOX_SCMI
	help
	  This enables Baikal specific SCMI Base Extension protocol to
	  exchange data with XCP-FW.

config BAIKAL_SCMI_BASE_EXT_ACPI
	tristate "Baikal SCMI Base Extension protocol ACPI driver"
	depends on ARCH_BAIKAL || COMPILE_TEST
	depends on ACPI
	select PCC
	help
	  This enables Baikal specific SCMI Base Extension protocol based
	  on PCC transport to exchange data with XCP-FW.
```

## drivers/phy/baikal/Kconfig
```kconfig
# SPDX-License-Identifier: GPL-2.0-only

config USB_PHY_BAIKAL
	tristate "Baikal USB PHY driver"
	depends on USB_SUPPORT
	select GENERIC_PHY
	select USB_PHY
	help
	  Enable this to support the USB PHY on Baikal SoCs.
	  This driver controls both the USB2 PHY and the USB3 PHY.
```

## sound/soc/baikal/Kconfig
```kconfig
# SPDX-License-Identifier: GPL-2.0-only
config SND_BAIKAL_I2S
	tristate "Baikal SoC I2S Device Driver"
	depends on HAVE_CLK
	select SND_SOC_GENERIC_DMAENGINE_PCM
	select SND_SIMPLE_CARD_UTILS if ACPI
	help
	 Say Y or M if you want to add support for I2S driver for
	 Baikal SoC I2S device. The device supports up to
	 a maximum of 8 channels each for play and record.

config SND_BAIKAL_PIO_PCM
	bool "PCM PIO extension for Baikal SoC I2S driver"
	depends on SND_BAIKAL_I2S
	help
	 Say Y or N if you want to add a custom ALSA extension that registers
	 a PCM and uses PIO to transfer data.

	 This functionality is specially suited for I2S devices that don't have
	 DMA support.
```
