// SPDX-License-Identifier: GPL-2.0
/*
 * Device tree include file for BE-S1000 SoC CoreSight subsystem
 * Copyright (C) 2023-2025 Baikal Electronics, JSC
 */

#include <dt-bindings/arm/coresight-cti-dt.h>

#define CA75_DEBUG(chip, cl, c, hbase, base, n)							\
	debug##c: debug@##hbase##base##n##10000 {						\
		compatible = "arm,coresight-cpu-debug", "arm,primecell";			\
		reg = <0x##hbase 0x##base##n##10000 0x0 0x1000>;				\
		clocks = <&soc##chip##_ca75_##cl##_cmu0_clkch 2>;				\
		clock-names = "apb_pclk";							\
		cpu = <&cpu##c>;								\
	};											\
												\
	etm##c: etm@##hbase##base##n##40000 {							\
		compatible = "arm,coresight-etm4x", "arm,primecell";				\
		reg = <0x##hbase 0x##base##n##40000 0x0 0x1000>;				\
		clocks = <&soc##chip##_ca75_##cl##_cmu0_clkch 2>;				\
		clock-names = "apb_pclk";							\
		cpu = <&cpu##c>;								\
												\
		out-ports {									\
			port {									\
				etm##c##_out_port: endpoint {					\
					remote-endpoint =					\
						<&soc##chip##_funnel##cl##_in_port##n>;		\
				};								\
			};									\
		};										\
	};											\
												\
	cti##c: cti@##hbase##base##n##20000 {							\
		compatible = "arm,coresight-cti-v8-arch", "arm,coresight-cti",			\
			     "arm,primecell";							\
		reg = <0x##hbase 0x##base##n##20000 0x0 0x1000>;				\
		clocks = <&soc##chip##_ca75_##cl##_cmu0_clkch 2>;				\
		clock-names = "apb_pclk";							\
		cpu = <&cpu##c>;								\
		arm,cs-dev-assoc = <&etm##c>;							\
	}

#define CA75_CORESIGHT(chip, cl, c0, c1, c2, c3, hbase, cs_base, debug_base)		\
	CA75_DEBUG(chip,cl,c0,hbase,debug_base,0);					\
	CA75_DEBUG(chip,cl,c1,hbase,debug_base,1);					\
	CA75_DEBUG(chip,cl,c2,hbase,debug_base,2);					\
	CA75_DEBUG(chip,cl,c3,hbase,debug_base,3);					\
											\
	soc##chip##_funnel##cl: funnel@##hbase##cs_base##020000 {			\
		compatible = "arm,coresight-dynamic-funnel", "arm,primecell";		\
		reg = <0x##hbase 0x##cs_base##020000 0x0 0x1000>;			\
		clocks = <&soc##chip##_ca75_##cl##_cmu0_clkch 2>;			\
		clock-names = "apb_pclk";						\
											\
		out-ports {								\
			port {								\
				soc##chip##_funnel##cl##_out_port: endpoint {		\
					remote-endpoint =				\
						<&soc##chip##_etb##cl##_in_port>;	\
				};							\
			};								\
		};									\
											\
		in-ports {								\
			#address-cells = <1>;						\
			#size-cells = <0>;						\
											\
			port@0 {							\
				reg = <0>;						\
				soc##chip##_funnel##cl##_in_port0: endpoint {		\
					remote-endpoint =				\
						<&etm##c0##_out_port>;			\
				};							\
			};								\
											\
			port@1 {							\
				reg = <1>;						\
				soc##chip##_funnel##cl##_in_port1: endpoint {		\
					remote-endpoint =				\
						<&etm##c1##_out_port>;			\
				};							\
			};								\
											\
			port@2 {							\
				reg = <2>;						\
				soc##chip##_funnel##cl##_in_port2: endpoint {		\
					remote-endpoint =				\
						<&etm##c2##_out_port>;			\
				};							\
			};								\
											\
			port@3 {							\
				reg = <3>;						\
				soc##chip##_funnel##cl##_in_port3: endpoint {		\
					remote-endpoint =				\
						<&etm##c3##_out_port>;			\
				};							\
			};								\
		};									\
	};										\
											\
	soc##chip##_etb##cl: etb@##hbase##cs_base##030000 {				\
		compatible = "arm,coresight-tmc", "arm,primecell";			\
		reg = <0x##hbase 0x##cs_base##030000 0x0 0x1000>;			\
		clocks = <&soc##chip##_ca75_##cl##_cmu0_clkch 2>;			\
		clock-names = "apb_pclk";						\
											\
		in-ports {								\
			port {								\
				soc##chip##_etb##cl##_in_port: endpoint {		\
					remote-endpoint =				\
						<&soc##chip##_funnel##cl##_out_port>;	\
				};							\
			};								\
		};									\
	};										\
											\
	soc##chip##_cti##cl: cti@##hbase##cs_base##010000 {				\
		compatible = "arm,coresight-cti", "arm,primecell";			\
		reg = <0x##hbase 0x##cs_base##010000 0x0 0x1000>;			\
		clocks = <&soc##chip##_ca75_##cl##_cmu0_clkch 2>;			\
		clock-names = "apb_pclk";						\
											\
		#address-cells = <1>;							\
		#size-cells = <0>;							\
											\
		trig-conns@0 {								\
			reg = <0>;							\
			arm,trig-in-sigs = <0 1 2>;					\
			arm,trig-in-types = <SNK_ACQCOMP SNK_FULL			\
					     SNK_FLUSHCOMP>;				\
			arm,trig-out-sigs = <0 1>;					\
			arm,trig-out-types = <SNK_FLUSHIN SNK_TRIGIN>;			\
			arm,cs-dev-assoc = <&soc##chip##_etb##cl>;			\
		};									\
											\
		trig-conns@1 {								\
			reg = <1>;							\
			arm,trig-out-sigs = <2>;					\
			arm,trig-conn-name = "pmu_snapshot";				\
		};									\
	}

#define SOC_CORESIGHT(chip, hbase)							\
	/* STM Block */									\
											\
	soc##chip##_etr: etr@##hbase##02080000 {					\
		compatible = "arm,coresight-tmc", "arm,primecell";			\
		reg = <0x##hbase 0x2080000 0x0 0x1000>;					\
		clocks = <&soc##chip##_sc_cmu1_clkch 6>;				\
		clock-names = "apb_pclk";						\
											\
		in-ports {								\
			port {								\
				soc##chip##_etr_in_port: endpoint {			\
					remote-endpoint =				\
						<&soc##chip##_etf_out_port>;		\
				};							\
			};								\
		};									\
	};										\
											\
	soc##chip##_etf: etf@##hbase##02070000 {					\
		compatible = "arm,coresight-tmc", "arm,primecell";			\
		reg = <0x##hbase 0x2070000 0x0 0x1000>;					\
		clocks = <&soc##chip##_sc_cmu1_clkch 6>;				\
		clock-names = "apb_pclk";						\
											\
		out-ports {								\
			port {								\
				soc##chip##_etf_out_port: endpoint {			\
					remote-endpoint =				\
						<&soc##chip##_etr_in_port>;		\
				};							\
			};								\
		};									\
											\
		in-ports {								\
			port {								\
				soc##chip##_etf_in_port: endpoint {			\
					remote-endpoint =				\
						<&soc##chip##_stm_out_port>;		\
				};							\
			};								\
		};									\
	};										\
											\
	soc##chip##_stm: stm@##hbase##02060000 {					\
		compatible = "arm,coresight-stm", "arm,primecell";			\
		reg = <0x##hbase 0x2060000 0x0 0x1000>,					\
		      <0x##hbase 0x3000000 0x0 0x1000000>;				\
		reg-names = "stm-base", "stm-stimulus-base";				\
		clocks = <&soc##chip##_sc_cmu1_clkch 6>;				\
		clock-names = "apb_pclk";						\
											\
		out-ports {								\
			port {								\
				soc##chip##_stm_out_port: endpoint {			\
					remote-endpoint =				\
						<&soc##chip##_etf_in_port>;		\
				};							\
			};								\
		};									\
	};										\
											\
	/* CMN Block */									\
											\
	soc##chip##_funnel: funnel@##hbase##02050000 {					\
		compatible = "arm,coresight-dynamic-funnel",				\
			     "arm,primecell";						\
		reg = <0x##hbase 0x2050000 0x0 0x1000>;					\
		clocks = <&soc##chip##_sc_cmu1_clkch 6>;				\
		clock-names = "apb_pclk";						\
											\
		out-ports {								\
			port {								\
				soc##chip##_funnel_out_port: endpoint {			\
					remote-endpoint =				\
						<&soc##chip##_etb_in_port>;		\
				};							\
			};								\
		};									\
											\
		in-ports {								\
			#address-cells = <1>;						\
			#size-cells = <0>;						\
											\
			port@0 {							\
				reg = <0>;						\
				soc##chip##_funnel_in_port0: endpoint {			\
				};							\
			};								\
											\
			port@1 {							\
				reg = <1>;						\
				soc##chip##_funnel_in_port1: endpoint {			\
				};							\
			};								\
		};									\
	};										\
											\
	soc##chip##_etb: etb@##hbase##02040000 {					\
		compatible = "arm,coresight-tmc", "arm,primecell";			\
		reg = <0x##hbase 0x2040000 0x0 0x1000>;					\
		clocks = <&soc##chip##_sc_cmu1_clkch 6>;				\
		clock-names = "apb_pclk";						\
											\
		in-ports {								\
			port {								\
				soc##chip##_etb_in_port: endpoint {			\
					remote-endpoint =				\
						<&soc##chip##_funnel_out_port>;		\
				};							\
			};								\
		};									\
	};										\
											\
	/* CTI */									\
											\
	soc##chip##_cti: cti@##hbase##02010000 {					\
		compatible = "arm,coresight-cti", "arm,primecell";			\
		reg = <0x##hbase 0x2010000 0x0 0x1000>;					\
		clocks = <&soc##chip##_sc_cmu1_clkch 6>;				\
		clock-names = "apb_pclk";						\
											\
		#address-cells = <1>;							\
		#size-cells = <0>;							\
											\
		trig-conns@0 {								\
			reg = <0>;							\
			arm,trig-out-sigs = <0 1>;					\
			arm,trig-out-types = <GEN_HALTREQ				\
					      GEN_RESTARTREQ>;				\
			arm,trig-conn-name = "tsgen";					\
		};									\
											\
		trig-conns@1 {								\
			reg = <1>;							\
			arm,trig-in-sigs = <0 1 2>;					\
			arm,trig-in-types = <SNK_FULL SNK_ACQCOMP			\
					     SNK_FLUSHCOMP>;				\
			arm,trig-out-sigs = <2 3>;					\
			arm,trig-out-types = <SNK_FLUSHIN SNK_TRIGIN>;			\
			arm,cs-dev-assoc = <&soc##chip##_etb>;				\
		};									\
											\
		trig-conns@2 {								\
			reg = <2>;							\
			arm,trig-in-sigs = <3 4>;					\
			arm,trig-conn-name = "cmn_debug_watchtrig";			\
		};									\
											\
		trig-conns@3 {								\
			reg = <3>;							\
			arm,trig-out-sigs = <4>;					\
			arm,trig-conn-name = "cmn_pmu_snapshot";			\
		};									\
											\
		trig-conns@4 {								\
			reg = <4>;							\
			arm,trig-in-sigs = <5 6 7>;					\
			arm,trig-in-types = <SNK_ACQCOMP SNK_FULL			\
					     SNK_FLUSHCOMP>;				\
			arm,trig-out-sigs = <5 6>;					\
			arm,trig-out-types = <SNK_FLUSHIN SNK_TRIGIN>;			\
			arm,cs-dev-assoc = <&soc##chip##_etf>;				\
		};									\
											\
		trig-conns@5 {								\
			reg = <5>;							\
			arm,trig-in-sigs = <8 9 10>;					\
			arm,trig-in-types = <SNK_ACQCOMP SNK_FULL			\
					     SNK_FLUSHCOMP>;				\
			arm,trig-out-sigs = <7 8>;					\
			arm,trig-out-types = <SNK_FLUSHIN SNK_TRIGIN>;			\
			arm,cs-dev-assoc = <&soc##chip##_etr>;				\
		};									\
											\
		trig-conns@6 {								\
			reg = <6>;							\
			arm,trig-in-sigs = <11 12 13 14>;				\
			arm,trig-in-types = <STM_TOUT_SPTE STM_TOUT_SW			\
					     STM_TOUT_HETE STM_ASYNCOUT>;		\
			arm,trig-out-sigs = <9 10 11 12>;				\
			arm,trig-out-types = <STM_HWEVENT STM_HWEVENT			\
					      STM_HWEVENT STM_HWEVENT>;			\
			arm,cs-dev-assoc = <&soc##chip##_stm>;				\
		};									\
											\
		trig-conns@7 {								\
			reg = <7>;							\
			arm,trig-out-sigs = <13>;					\
			arm,trig-conn-name = "dpeventstatus";				\
		};									\
											\
		trig-conns@8 {								\
			reg = <8>;							\
			arm,trig-out-sigs = <14 15 16 17>;				\
			arm,trig-out-types = <GEN_INTREQ GEN_INTREQ			\
					      GEN_INTREQ GEN_INTREQ>;			\
			arm,trig-conn-name = "cti_interrupt";				\
		};									\
	}

/ {
	soc {
		CA75_CORESIGHT(0,0,0,1,2,3,0,06,07);
		CA75_CORESIGHT(0,1,4,5,6,7,0,0a,0b);
		CA75_CORESIGHT(0,2,8,9,10,11,0,0e,0f);
		CA75_CORESIGHT(0,3,12,13,14,15,0,12,13);
		CA75_CORESIGHT(0,4,16,17,18,19,0,16,17);
		CA75_CORESIGHT(0,5,20,21,22,23,0,1a,1b);
		CA75_CORESIGHT(0,6,24,25,26,27,0,1e,1f);
		CA75_CORESIGHT(0,7,28,29,30,31,0,22,23);
		CA75_CORESIGHT(0,8,32,33,34,35,0,26,27);
		CA75_CORESIGHT(0,9,36,37,38,39,0,2a,2b);
		CA75_CORESIGHT(0,10,40,41,42,43,0,2e,2f);
		CA75_CORESIGHT(0,11,44,45,46,47,0,32,33);

		SOC_CORESIGHT(0,0);
	};
};
